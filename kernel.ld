/* ===========================================================================
 *  kernel.ld — линковочный скрипт для ядра
 * ===========================================================================
 *  Говорит линковщику, КУДА разместить код ядра в памяти и КАК склеить
 *  секции вплотную (без пустот, которые добавляет PE по умолчанию).
 *
 *  Точка входа: _kernel_main (MinGW добавляет подчёркивание к именам C-функций)
 *  Базовый адрес: 0x10000 — именно туда stage2.asm загрузит ядро с диска.
 * =========================================================================== */

ENTRY(_kernel_main)          /* точка входа ядра (с подчёркиванием от MinGW) */

SECTIONS
{
    . = 0x10000;             /* начинаем размещать по адресу 0x10000 */

    .text : {                /* ВСЁ складываем в одну сплошную секцию .text */
        *(.text)             /* машинный код наших функций */
        *(.text.*)
        *(.rdata)            /* строки (сюда же — ВПЛОТНУЮ, без дыр) */
        *(.rdata.*)
        *(.rodata)
        *(.rodata.*)
        *(.data)             /* и данные, если будут */
        *(.data.*)
    }

    /DISCARD/ : {            /* ВЫБРАСЫВАЕМ ненужное, чтобы код начался с 0x10000 */
        *(.comment)          /* мусор вида "GCC: (GNU) 16.2.0" — НЕ код! */
        *(.comment.*)
        *(.note)             /* служебные записи ELF/PE — тоже не нужны */
        *(.note.*)
        *(.eh_frame)         /* таблицы исключений — в ядре не используются */
        *(.eh_frame.*)
    }
}
