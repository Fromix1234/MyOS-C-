/* ===========================================================================
 *  shell.ld — линковочный скрипт для ГРАФИЧЕСКОЙ ОБОЛОЧКИ (shell.bin)
 * ===========================================================================
 *  Оболочка — отдельная программа ring 3 (как обычный процесс в Linux).
 *  Ядро грузит shell.bin с диска в память программ по адресу 0x400000 и
 *  стартует задачу: первая же инструкция образа — пролог shell_main.
 *
 *  Поэтому .text.entry идёт ПЕРВОЙ секцией: ядру не нужно искать точку
 *  входа в таблицах — достаточно прыгнуть на адрес 0x400000.
 *
 *  Точка входа: _shell_main (MinGW добавляет подчёркивание к именам C-функций)
 *  Базовый адрес: 0x400000 (SHELL_BASE из common/myos.h)
 * =========================================================================== */

ENTRY(_shell_main)           /* точка входа оболочки (с подчёркиванием MinGW) */

SECTIONS
{
    . = 0x400000;            /* сюда ядро копирует shell.bin (SHELL_BASE) */

    .text : {                /* ВСЁ складываем в одну сплошную секцию .text */
        *(.text.entry)       /* точка входа — В САМОМ НАЧАЛЕ образа! */
        *(.text)             /* машинный код остальных функций */
        *(.text.*)
        *(.rdata)            /* строки (вплотную, без дыр) */
        *(.rdata.*)
        *(.rdata$*)          /* в т.ч. .rdata$zzz — «GCC: (GNU)...» от MinGW */
        *(.rodata)
        *(.rodata.*)
        *(.data)             /* и данные (шрифт, иконки — уже разложены) */
        *(.data.*)
    }

    /DISCARD/ : {            /* мусор, который не должен попасть в образ */
        *(.comment)          /* "GCC: (GNU) ..." — не код */
        *(.comment.*)
        *(.note)
        *(.note.*)
        *(.eh_frame)         /* таблицы исключений — не нужны */
        *(.eh_frame.*)
    }
}
