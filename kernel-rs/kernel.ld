/* ===========================================================================
 *  kernel-rs/kernel.ld — линковочный скрипт для Rust-ядра (MyOS v3)
 * ===========================================================================
 *  Отличия от C++-скрипта:
 *    * .data тоже входит в плоский образ (у Rust есть инициализированные
 *      статики, например указатель на видеопамять);
 *    * .bss размещается ПОСЛЕ образа и отмечается символами __bss_start /
 *      __bss_end: в файл она не входит, ядро само её обнуляет на старте;
 *    * _image_end — настоящий конец плоского образа (для SYS_INFO/install);
 *    * секции с суффиксом $ (по функции/переменной): вместе с --gc-sections
 *      линкер выбрасывает неиспользуемый код core/compiler_builtins.
 *
 *  Точка входа: _kernel_main (MinGW/COFF добавляет подчёркивание).
 *  База: 0x10000 — сюда stage2 грузит kernel.bin.
 * =========================================================================== */

ENTRY(_kernel_main)

SECTIONS
{
    . = 0x10000;

    .text : {
        *(.text)
        *(.text.*)
        *(.text$*)
        *(.rdata)
        *(.rdata.*)
        *(.rdata$*)
        *(.rodata)
        *(.rodata.*)
        *(.data)
        *(.data.*)
        *(.data$*)
        . = ALIGN(16);
        __image_end = .;
    }

    .bss : {
        __bss_start = .;
        *(.bss)
        *(.bss.*)
        *(.bss$*)
        *(COMMON)
        . = ALIGN(16);
        __bss_end = .;
    }

    /DISCARD/ : {
        *(.comment*)
        *(.note*)
        *(.eh_frame*)
        *(.reloc*)
        *(.debug*)
        *(.llvm*)
        *(.pdata*)
        *(.xdata*)
        *(.gcc_except_table*)
    }
}
